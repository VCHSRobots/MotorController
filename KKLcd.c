/*
 * KKLcd.c
 *
 * Driver for the LCD on the KK board.  LCD on the KK board is a ST7565.
 *
 * Created: 1/21/2013 10:59:36 AM
 * Author: Dal
 */ 

#include "MainDef.h"
#include <string.h>
#include "KKLcd.h"

// For the KK board, the LCD is connected through PORT D on the following Pins
#define LCD_SID    LcdSiPin      //1    Output
#define LCD_SCLK   LcdSclPin     //4    Output
#define LCD_A0     LcdA0Pin      //7    Output
#define LCD_RST    LcdResetPin   //6    Output
#define LCD_CS     LcdCsPin      //5    Output
#define LCD_DirMask  (_BV(LCD_SID) | _BV(LCD_SCLK) | _BV(LCD_A0) | _BV(LCD_RST) | _BV(LCD_CS) )

// Constants for dealing with the ST7565.

#define CMD_DISPLAY_OFF 0xAE
#define CMD_DISPLAY_ON 0xAF

#define CMD_SET_DISP_START_LINE 0x40
#define CMD_SET_PAGE 0xB0

#define CMD_SET_COLUMN_UPPER 0x10
#define CMD_SET_COLUMN_LOWER 0x00

#define CMD_SET_ADC_NORMAL 0xA0
#define CMD_SET_ADC_REVERSE 0xA1

#define CMD_SET_DISP_NORMAL 0xA6
#define CMD_SET_DISP_REVERSE 0xA7

#define CMD_SET_ALLPTS_NORMAL 0xA4
#define CMD_SET_ALLPTS_ON 0xA5
#define CMD_SET_BIAS_9 0xA2
#define CMD_SET_BIAS_7 0xA3

#define CMD_RMW 0xE0
#define CMD_RMW_CLEAR 0xEE
#define CMD_INTERNAL_RESET 0xE2
#define CMD_SET_COM_NORMAL 0xC0
#define CMD_SET_COM_REVERSE 0xC8
#define CMD_SET_POWER_CONTROL 0x28
#define CMD_SET_RESISTOR_RATIO 0x20
#define CMD_SET_VOLUME_FIRST 0x81
#define CMD_SET_VOLUME_SECOND 0
#define CMD_SET_STATIC_OFF 0xAC
#define CMD_SET_STATIC_ON 0xAD
#define CMD_SET_STATIC_REG 0x0
#define CMD_SET_BOOSTER_FIRST 0xF8
#define CMD_SET_BOOSTER_234 0
#define CMD_SET_BOOSTER_5 1
#define CMD_SET_BOOSTER_6 3
#define CMD_NOP 0xE3
#define CMD_TEST 0xF0

// Local Functions

void KKLcd_SpiWrite(uint8_t c);
void KKLcd_Command(uint8_t c);
void KKLcd_Data(uint8_t c);
void KKLcd_Display(void);

// a handy reference to where the pages are on the screen
const uint8_t pagemap[] = { 3, 2, 1, 0, 7, 6, 5, 4 };

// a 6x8 font table
const PROGMEM uint8_t Font6x8[] = {
 	 0x00,0x00,0x00,0x00,0x00,0x00,	//
 	 0x10,0xE3,0x84,0x10,0x01,0x00,	// !
 	 0x6D,0xB4,0x80,0x00,0x00,0x00,	// &quot;
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 	 0x10,0xE6,0xD1,0x45,0xF0,0x00 
};
	  
const PROGMEM uint8_t Font8x12[] = {
		0x00,0x00,0x00,0x00,0x00,0x00,0x00,0x00,0x00,0x00,0x00,0x00,	//
		0x00,0x30,0x78,0x78,0x78,0x30,0x30,0x00,0x30,0x30,0x00,0x00,	// !
		0x00,0x66,0x66,0x66,0x24,0x00,0x00,0x00,0x00,0x00,0x00,0x00,	// &quot;
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		0x00,0x00,0x00,0x10,0x38,0x6C,0xC6,0xC6,0xFE,0x00,0x00,0x00 	// 
};		  

//// Shortened 12x16 font.  Can be used to save Program Memory space
//#define Font12x16Size 24  // Number of actual characters implemented in the 12x16 font.
//#define Font12x16ErrIndex 19
//const PROGMEM uint8_t Font12x16Index[] = "0123456789ABCDEF.-+# :NO";  // How the characters are indexed in the table.
//const PROGMEM uint8_t Font12x16[] = {
	//0x0F,0x83,0xFE,0x30,0x66,0x07,0x60,0xF6,0x1B,0x63,0x36,0x63,0x6C,0x37,0x83,0x70,0x33,0x06,0x3F,0xE0,0xF8,0x00,0x00,0x00, // 0
	//0x03,0x00,0x70,0x1F,0x01,0xF0,0x03,0x00,0x30,0x03,0x00,0x30,0x03,0x00,0x30,0x03,0x00,0x30,0x1F,0xE1,0xFE,0x00,0x00,0x00, // 1
    //0x1F,0xC3,0xFE,0x70,0x76,0x03,0x60,0x70,0x0E,0x01,0xC0,0x38,0x07,0x00,0xE0,0x1C,0x03,0x80,0x7F,0xF7,0xFF,0x00,0x00,0x00, // 2
	//0x1F,0xC3,0xFE,0x70,0x76,0x03,0x00,0x30,0x07,0x0F,0xE0,0xFC,0x00,0x60,0x03,0x60,0x37,0x07,0x3F,0xE1,0xFC,0x00,0x00,0x00, // 3
	//0x01,0xC0,0x3C,0x07,0xC0,0xEC,0x1C,0xC3,0x8C,0x70,0xC6,0x0C,0x7F,0xF7,0xFF,0x00,0xC0,0x0C,0x00,0xC0,0x0C,0x00,0x00,0x00, // 4
	//0x7F,0xF7,0xFF,0x60,0x06,0x00,0x60,0x07,0xFC,0x3F,0xE0,0x07,0x00,0x30,0x03,0x60,0x37,0x07,0x3F,0xE1,0xFC,0x00,0x00,0x00, // 5
	//0x03,0xC0,0x7C,0x0E,0x01,0xC0,0x38,0x03,0x00,0x7F,0xC7,0xFE,0x70,0x76,0x03,0x60,0x37,0x07,0x3F,0xE1,0xFC,0x00,0x00,0x00, // 6
	//0x7F,0xF7,0xFF,0x00,0x60,0x06,0x00,0xC0,0x0C,0x01,0x80,0x18,0x03,0x00,0x30,0x06,0x00,0x60,0x0C,0x00,0xC0,0x00,0x00,0x00, // 7
	//0x0F,0x81,0xFC,0x38,0xE3,0x06,0x30,0x63,0x8E,0x1F,0xC3,0xFE,0x70,0x76,0x03,0x60,0x37,0x07,0x3F,0xE1,0xFC,0x00,0x00,0x00, // 8
	//0x1F,0xC3,0xFE,0x70,0x76,0x03,0x60,0x37,0x07,0x3F,0xF1,0xFF,0x00,0x60,0x0E,0x01,0xC0,0x38,0x1F,0x01,0xE0,0x00,0x00,0x00, // 9
    //0x06,0x00,0x60,0x0F,0x00,0xF0,0x0F,0x01,0x98,0x19,0x81,0x98,0x30,0xC3,0xFC,0x3F,0xC6,0x06,0x60,0x66,0x06,0x00,0x00,0x00, // A
    //0x7F,0x07,0xF8,0x61,0xC6,0x0C,0x60,0xC6,0x1C,0x7F,0x87,0xFC,0x60,0xE6,0x06,0x60,0x66,0x0E,0x7F,0xC7,0xF8,0x00,0x00,0x00, // B
    //0x0F,0x81,0xFC,0x38,0xE3,0x06,0x60,0x06,0x00,0x60,0x06,0x00,0x60,0x06,0x00,0x30,0x63,0x8E,0x1F,0xC0,0xF8,0x00,0x00,0x00, // C
    //0x7F,0x07,0xF8,0x61,0xC6,0x0C,0x60,0x66,0x06,0x60,0x66,0x06,0x60,0x66,0x06,0x60,0xC6,0x1C,0x7F,0x87,0xF0,0x00,0x00,0x00, // D
    //0x7F,0xE7,0xFE,0x60,0x06,0x00,0x60,0x06,0x00,0x7F,0x87,0xF8,0x60,0x06,0x00,0x60,0x06,0x00,0x7F,0xE7,0xFE,0x00,0x00,0x00, // E
    //0x7F,0xE7,0xFE,0x60,0x06,0x00,0x60,0x06,0x00,0x7F,0x87,0xF8,0x60,0x06,0x00,0x60,0x06,0x00,0x60,0x06,0x00,0x00,0x00,0x00, // F	
    //0x00,0x00,0x00,0x00,0x00,0x00,0x00,0x00,0x00,0x00,0x00,0x00,0x00,0x00,0x00,0x00,0x00,0xE0,0x0E,0x00,0xE0,0x00,0x00,0x00, // .	  = 16 = DecimalIndex
	//0x00,0x00,0x00,0x00,0x00,0x00,0x00,0x00,0x00,0x00,0x03,0xFC,0x3F,0xC0,0x00,0x00,0x00,0x00,0x00,0x00,0x00,0x00,0x00,0x00, // -     = 17 = MinusIndex  
	//0x00,0x00,0x00,0x00,0x00,0x00,0x06,0x00,0x60,0x06,0x03,0xFC,0x3F,0xC0,0x60,0x06,0x00,0x60,0x00,0x00,0x00,0x00,0x00,0x00, // +     = 18 = PlusIndex
	//0x00,0x00,0x66,0x06,0x60,0x66,0x3F,0xF0,0xCC,0x0C,0xC1,0x98,0x19,0x87,0xFC,0x33,0x03,0x30,0x33,0x00,0x00,0x00,0x00,0x00, // #     = 19 = HashIndex
	//0x00,0x00,0x00,0x00,0x00,0x00,0x00,0x00,0x00,0x00,0x00,0x00,0x00,0x00,0x00,0x00,0x00,0x00,0x00,0x00,0x00,0x00,0x00,0x00, // space = 20 = SpaceIndex
	//0x00,0x00,0x00,0x00,0x00,0x00,0x0E,0x00,0xE0,0x0E,0x00,0x00,0x00,0x00,0x00,0x0E,0x00,0xE0,0x0E,0x00,0x00,0x00,0x00,0x00, // :     = 21
	//0x60,0x67,0x06,0x70,0x67,0x86,0x6C,0x66,0xC6,0x66,0x66,0x66,0x63,0x66,0x36,0x61,0xE6,0x0E,0x60,0xE6,0x06,0x00,0x00,0x00, // N     = 22
	//0x0F,0x01,0xF8,0x39,0xC3,0x0C,0x60,0x66,0x06,0x60,0x66,0x06,0x60,0x66,0x06,0x30,0xC3,0x9C,0x1F,0x80,0xF0,0x00,0x00,0x00	 // O     = 23
//};	

// Entire 12x16 Font here... 
const PROGMEM uint8_t Font12x16[] = {
0x00,0x00,0x00,0x00,0x00,0x00,0x00,0x00,0x00,0x00,0x00,0x00,0x00,0x00,0x00,0x00,0x00,0x00,0x00,0x00,0x00,0x00,0x00,0x00, //
0x06,0x00,0x60,0x0F,0x00,0xF0,0x0F,0x00,0xF0,0x0F,0x00,0x60,0x06,0x00,0x60,0x00,0x00,0x00,0x06,0x00,0x60,0x00,0x00,0x00, // !
0x00,0x00,0x00,0x19,0x81,0x98,0x19,0x81,0x98,0x00,0x00,0x00,0x00,0x00,0x00,0x00,0x00,0x00,0x00,0x00,0x00,0x00,0x00,0x00, // &quot;
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0x00,0x00,0x00,0x00,0x00,0x00,0x06,0x00,0xF0,0x19,0x83,0x0C,0x60,0x66,0x06,0x7F,0xE7,0xFE,0x00,0x00,0x00,0x00,0x00,0x00 };


// The memory buffer for the LCD
uint8_t st7565_buffer[1024];

#define swap(a, b) {uint8_t t=a; a=b; b=t;}

uint8_t KKLcd_X0 = 0;
uint8_t KKLcd_Y0 = 0;
static uint8_t bKKLcdInited = False;

// --------------------------------------------------------
// Sets the cursor position for printing chars or strings.
// Size of display is 128 wide by 64 high, with origin at lower left.
void KKLcd_SetCursor(uint8_t x0, uint8_t y0)
{
	KKLcd_X0 = x0;
	KKLcd_Y0 = y0;	
}	

// --------------------------------------------------------
// Print a string into the LCD's memory buffer, starting
// at current cursor position.  Cursor position is advanced.
// Characters are from the 6x8 Font.
void KKLcd_PrintString6x8(const char *s)
{
	while(*s != 0) KKLcd_Put6x8Char(*s++);
}

// --------------------------------------------------------
// Print a string into the LCD's memory buffer, starting
// at current cursor position.  Cursor position is advanced.
// Characters are from the 6x8 Font.  NOTE: The input
// for this routine is a string in Program Memory.
void KKLcd_PrintString6x8_P(const char *s)
{
	while(pgm_read_byte(s) != 0) 
	{	
		char b = pgm_read_byte(s++);
		KKLcd_Put6x8Char(b);
	}		
}

// --------------------------------------------------------
// Print a string into the LCD's memory buffer, starting
// at current cursor position.  Cursor position is advanced.
// Characters are from the 8x12 Font.
void KKLcd_PrintString8x12(const char *s)
{
	while(*s != 0) KKLcd_Put8x12Char(*s++);
}

// --------------------------------------------------------
// Print a string into the LCD's memory buffer, starting
// at current cursor position.  Cursor position is advanced.
// Characters are from the 8x12 Font.  NOTE: The input
// for this routine is a string in Program Memory.
void KKLcd_PrintString8x12_P(const char *s)
{
	while(pgm_read_byte(s) != 0)
	{
		char b = pgm_read_byte(s++);
		KKLcd_Put8x12Char(b);
	}
}

// --------------------------------------------------------
// Print a string into the LCD's memory buffer, starting
// at current cursor position.  Cursor position is advanced.
// Characters are from the 12x16 Font.  Note that not all
// ASCII characters are implemented in the 12x16 font.
void KKLcd_PrintString12x16(const char *s)
{
	while(*s != 0) KKLcd_Put12x16Char(*s++);
}

// --------------------------------------------------------
// Print a string into the LCD's memory buffer, starting
// at current cursor position.  Cursor position is advanced.
// Characters are from the 12x16 Font.  NOTE: The input
// for this routine is a string in Program Memory.
// ** Also note that not all ASCII characters are implemented
// in the 12x16 font.
void KKLcd_PrintString12x16_P(const char *s)
{
	while(pgm_read_byte(s) != 0)
	{
		char b = pgm_read_byte(s++);
		KKLcd_Put12x16Char(b);
	}
}

// --------------------------------------------------------
// Prints one 6x8 char into the LCD's memory buffer at 
// current cursor position.  Advances cursor position 
// when done.
void KKLcd_Put6x8Char(uint8_t c)
{
	uint16_t icp = c - ' ';  // Get location in Font table.
	if(icp < 0 || icp > 127) return;
	icp *= 6; 
	uint8_t bb = pgm_read_byte(Font6x8 + icp);
	int8_t ibit = 7;
	for(uint8_t iy = 0; iy < 8; iy++)
	{
		uint8_t y = KKLcd_Y0 + 8 - iy;
		for(uint8_t ix = 0; ix < 6; ix++)
		{
			uint8_t px = bb & _BV(ibit);
			KKLcd_SetPixel(KKLcd_X0 + ix, y, px);
			ibit--;
			if(ibit < 0)
			{
				icp++;
				bb = pgm_read_byte(Font6x8 + icp);
				ibit = 7;
			}
		}
	}
	KKLcd_X0 += 6;
	if(KKLcd_X0 > 122) {KKLcd_X0 = 0; KKLcd_Y0 -= 8; }
}

// --------------------------------------------------------
// Prints one 8x12 char into the LCD's memory buffer at
// current cursor position.  Advances cursor position
// when done.
void KKLcd_Put8x12Char(uint8_t c)
{
	uint16_t icp = c - ' ';  // Get location in Font table.
	if(icp < 0 || icp > 127) return;
	icp *= 12;
	uint8_t bb = pgm_read_byte(Font8x12 + icp);
	int8_t ibit = 7;
	for(uint8_t iy = 0; iy < 12; iy++)
	{
		uint8_t y = KKLcd_Y0 + 12 - iy;
		for(uint8_t ix = 0; ix < 8; ix++)
		{
			uint8_t px = bb & _BV(ibit);
			KKLcd_SetPixel(KKLcd_X0 + ix, y, px);
			ibit--;
			if(ibit < 0)
			{
				icp++;
				bb = pgm_read_byte(Font8x12 + icp);
				ibit = 7;
			}
		}
	}
	KKLcd_X0 += 8;
	if(KKLcd_X0 > 120) {KKLcd_X0 = 0; KKLcd_Y0 -= 12; }
}

// --------------------------------------------------------
// Prints one 12x16 char into the LCD's memory buffer at
// current cursor position.  Advances cursor position
// when done.  I
void KKLcd_Put12x16Char(uint8_t c)
{
    uint16_t icp = c - ' ';  // Get location in Font table.
    if(icp < 0 || icp > 127) return;
    icp *= 24;        
    uint8_t bb = pgm_read_byte(Font12x16 + icp);
    int8_t ibit = 7;
    for(uint8_t iy = 0; iy < 16; iy++)
    {
        uint8_t y = KKLcd_Y0 + 16 - iy;
        for(uint8_t ix = 0; ix < 12; ix++)
        {
            uint8_t px = bb & _BV(ibit);
            KKLcd_SetPixel(KKLcd_X0 + ix, y, px);
            ibit--;
            if(ibit < 0)
            {
                icp++;
                bb = pgm_read_byte(Font12x16 + icp);
                ibit = 7;
            }
        }
    }
    KKLcd_X0 += 12;
    if(KKLcd_X0 > 116) {KKLcd_X0 = 0; KKLcd_Y0 -= 16; }
}

// Routines to used Shortened 12x16 font table...
//// --------------------------------------------------------
//// Prints one 12x16 char into the LCD's memory buffer at
//// current cursor position.  Advances cursor position
//// when done.  Although input is an ASCII char, not
//// all characters are implemented.  See table above.
//void KKLcd_Put12x16Char(uint8_t c)
//{
	//// Search for char in the index...
	//for(int i = 0; i < Font12x16Size; i++)
	//{
		//if(pgm_read_byte(Font12x16Index + i) == c) {KKLcd_Put12x16(i); return;}
	//}
	//KKLcd_Put12x16(Font12x16ErrIndex);  // A hash gets printed if the char is not implemented.
//}
//
//
//// --------------------------------------------------------
//// Prints one 12x16 char into the LCD's memory buffer at
//// current cursor position.  Advances cursor position
//// when done.  Input is index into table -- its not
//// ASCII!  See FONT table (above) for values of the indices.
//void KKLcd_Put12x16(uint8_t iIndex)
//{
	//if(iIndex >= Font12x16Size) return;
	//uint16_t icp = iIndex * 24;  // Get location in Font table.
	//uint8_t bb = pgm_read_byte(Font12x16 + icp);
	//int8_t ibit = 7;
	//for(uint8_t iy = 0; iy < 16; iy++)
	//{
		//uint8_t y = KKLcd_Y0 + 16 - iy;
		//for(uint8_t ix = 0; ix < 12; ix++)
		//{
			//uint8_t px = bb & _BV(ibit);
			//KKLcd_SetPixel(KKLcd_X0 + ix, y, px);
			//ibit--;
			//if(ibit < 0)
			//{
				//icp++;
				//bb = pgm_read_byte(Font12x16 + icp);
				//ibit = 7;
			//}
		//}
	//}
	//KKLcd_X0 += 12;
	//if(KKLcd_X0 > 116) {KKLcd_X0 = 0; KKLcd_Y0 -= 16; }
//}

// --------------------------------------------------------
// KKLcd_Box()
// Draws a box around with given corners.
void KKLcd_Box(uint8_t x0, uint8_t y0, uint8_t x1, uint8_t y1)
{
	KKLcd_Line(x0, y0, x0, y1);  // Left Side
	KKLcd_Line(x1, y0, x1, y1);  // Right Side
	KKLcd_Line(x0, y0, x1, y0);  // Bottom
	KKLcd_Line(x0, y1, x1, y1);  // Top
}

// --------------------------------------------------------
// Draws a line in the LCD's memory.
void KKLcd_Line(uint8_t x0, uint8_t y0, uint8_t x1, uint8_t y1)
{
	uint8_t steep = abs(y1-y0) > abs(x1 - x0);
	if(steep)
	{
		swap(x0, y0);
		swap(x1, y1);
	}
	if(x0 > x1)
	{
		swap(x0, x1);
		swap(y0, y1);		
	}
	uint8_t dx = x1 - x0;
	uint8_t dy = abs(y1 - y0);
	int8_t err = dx / 2;
	uint8_t x = 0;
	uint8_t y = y0;
	int8_t ystep;
	if(y0 < y1) ystep = 1;
	else ystep = -1;
	for(x = x0; x < x1; x++)
	{
		if(steep) KKLcd_SetPixel(y, x, 1);
		else KKLcd_SetPixel(x, y, 1);
		err -= dy;
		if(err < 0)
		{
			y += ystep;
			err += dx;
		}
	}
}

// --------------------------------------------------------
// Clears the LCD memory.
void KKLcd_Clear(void)
{
	memset(st7565_buffer, 0, 1024);
}

// --------------------------------------------------------
// Sets a pixel in the memory buffer to either black or white.
void KKLcd_SetPixel(uint8_t x, uint8_t y, uint8_t color) 
{
  if ((x >= LCDWIDTH) || (y >= LCDHEIGHT))
    return;
	
  // Reverse X and Y, cause our display is upside down.
  x = LCDWIDTH - x;
  y = LCDHEIGHT - y;

  // x is which column
  if (color)
    st7565_buffer[x+ (y/8)*128] |= _BV(7-(y%8));
  else
    st7565_buffer[x+ (y/8)*128] &= ~_BV(7-(y%8));
}

// --------------------------------------------------------
// Gets a pixel from the memory buffer.
uint8_t KKLcd_Getpixel(uint8_t x, uint8_t y) 
{
  if ((x >= LCDWIDTH) || (y >= LCDHEIGHT))  return 0;
  
  // Reverse X and Y, cause our display is upside down.
  x = LCDWIDTH - x;
  y = LCDHEIGHT - y;

  return (st7565_buffer[x+ (y/8)*128] >> (7-(y%8))) & 0x1;
}

// --------------------------------------------------------
// Causes the entire memory buffer to be refreshed on the LCD.
void KKLcd_Update(void)
{
	KKLcd_Command(CMD_DISPLAY_ON);				// LCD ON
	KKLcd_Command(CMD_SET_DISP_START_LINE);		// Display start line set
	KKLcd_Command(CMD_SET_ADC_NORMAL);			// ADC
	KKLcd_Command(CMD_SET_DISP_NORMAL);			// nor/res
	KKLcd_Command(CMD_SET_ALLPTS_NORMAL);		// Display Normal
	KKLcd_Command(CMD_SET_BIAS_9);				// bias 1/9
	KKLcd_Command(CMD_RMW_CLEAR);				// End
	KKLcd_Command(CMD_SET_COM_REVERSE);			// COM
	KKLcd_Command(0x2f);						// Power control
	KKLcd_Command(0x24);						// Vreg int res ratio
	KKLcd_Command(CMD_SET_STATIC_OFF);			// Static
	KKLcd_Command(CMD_SET_STATIC_REG);			// off
	KKLcd_Command(CMD_SET_BOOSTER_FIRST);		// Booster
	KKLcd_Command(CMD_SET_COLUMN_LOWER);		// ratio
	KKLcd_Command(CMD_NOP);						// Nop
	
	KKLcd_Display();
}

// --------------------------------------------------------
// KKLcd_Setup()
// Setups the LCD.  Should be called one time at startup.
// Should also be called to start the LCD after calling
// KKLcd_Shutdown().
void KKLcd_Setup(void)
{
    //BitOn(DDRD, DisableLcdPin);  
    //BitOff(PORTD, DisableLcdPin);  // This gives the LCD power.

	DDRD |= LCD_DirMask;  // Set output pin directions on Port D

    BitOff(PORTD, LCD_SID); // Set the data bit to zero.
    BitOn(PORTD, LCD_SCLK); // Set the clock high -- it's "normal" state.
  
	// toggle RST low to reset; CS low so it'll listen to us
    BitOn(PORTD, LCD_CS);     // Set CS High
    BitOff(PORTD, LCD_RST);   // Toggle the RST low and back to high to get a reset.
    _delay_ms(500);           // Was 500.  Hopefully, 50 is okay.
    BitOn(PORTD, LCD_RST);

    bKKLcdInited = True;
}

// --------------------------------------------------------
// KKLcd_PowerDown()
// Turns the LCD off, by powering it down through a MOSFET
// switch.  Turns off the control lines first, to protect
// the LCD.
void KKLcd_PowerDown()
{
    //// Before we remove power, set the output as floating, without pullups.
    //DDRD &= ~LCD_DirMask;    // This sets the pins to inputs.
    //PORTD &= ~LCD_DirMask;   // This sets the pullups off.
//
    //// Now it should be safe to remove power from the LCD
    //BitOn(PORTD, DisableLcdPin);  // Causes MOSFET to turn off.
    //BitOff(DDRD, DisableLcdPin);  // Shuts control pin down to save power. Pullup on MOSFET takes over.

    bKKLcdInited = False;

}

// --------------------------------------------------------
// KKLcd_IsPowered()
// Returns True if the LCD is currently powered, False otherwise.
uint8_t KKLcd_IsPowered()
{
    return bKKLcdInited;
}

// --------------------------------------------------------
// KKLcd_SpiWrite()
// Write a byte out to the spi bus
void KKLcd_SpiWrite(uint8_t c) 
{
	PORTD &= ~_BV(LCD_CS);
	int8_t i;
	for (i = 7; i >= 0; i--)
	{
		if (c & _BV(i)) PORTD |= _BV(LCD_SID);
		else PORTD &= ~_BV(LCD_SID);
		PORTD &= ~_BV(LCD_SCLK);
		PORTD |= _BV(LCD_SCLK);
	}
	PORTD |= _BV(LCD_CS);
}	

// --------------------------------------------------------
// KKLcd_Command()
// Issue a command byte to the LCD
void KKLcd_Command(uint8_t c) 
{
	PORTD &= ~_BV(LCD_A0);
	KKLcd_SpiWrite(c);
}

// --------------------------------------------------------
// KKLcd_Data()
// Write a data byte to the LCD
void KKLcd_Data(uint8_t c) 
{
	PORTD |= _BV(LCD_A0);
	KKLcd_SpiWrite(c);
}

// --------------------------------------------------------
// KKLcd_SetBrightness()
// Sets the LCD Brightness
// Input value should be between 0 and 127.
void KKLcd_SetBrightness(uint8_t val) 
{
    KKLcd_Command(CMD_SET_VOLUME_FIRST);
    KKLcd_Command(CMD_SET_VOLUME_SECOND | (val & 0x3f));
}

// -------------------------------------------------------
// KKLcd_Display()
// Writes the contents of the current buffer to the LCD
void KKLcd_Display(void) 
{
	uint8_t col, p;

	for(p = 0; p < 8; p++) 
	{
		col = 0;
		
		KKLcd_Command(CMD_SET_PAGE | pagemap[p]);
		//KKLcd_Command(CMD_SET_COLUMN_LOWER | (0x00 & 0x0F));
		//KKLcd_Command(CMD_SET_COLUMN_UPPER | ((0x00 >> 4) & 0x0F));
		KKLcd_Command(CMD_SET_COLUMN_LOWER);
		KKLcd_Command(CMD_SET_COLUMN_UPPER);
		KKLcd_Command(CMD_RMW);
		//KKLcd_Data(0xff);
		//KKLcd_Data(0x80);
		
		uint8_t pp = p + 4;
		if(pp >= 8) pp -= 8;
		
		for(col = 0; col < 128; col++)
		{
			KKLcd_Data(st7565_buffer[(128*pp)+col]);
		}
	}
}


